## buildroot/configs/cat_gif_rpi3_64_defconfig
```kconfig
BR2_aarch64=y
BR2_ARM_FPU_VFPV4=y
BR2_TOOLCHAIN_EXTERNAL=y
BR2_TOOLCHAIN_EXTERNAL_BOOTLIN=y
BR2_TOOLCHAIN_EXTERNAL_BOOTLIN_AARCH64_GLIBC_STABLE=y
BR2_GLOBAL_PATCH_DIR="board/raspberrypi/patches"
BR2_DOWNLOAD_FORCE_CHECK_HASHES=y
BR2_TARGET_GENERIC_HOSTNAME="cat-gif-viewer"
BR2_TARGET_GENERIC_ISSUE="The cat-gif viewer"
BR2_ROOTFS_DEVICE_CREATION_DYNAMIC_EUDEV=y
BR2_TARGET_GENERIC_ROOT_PASSWD="changeme"
BR2_SYSTEM_DHCP="eth0"
BR2_ROOTFS_USERS_TABLES="$(BR2_EXTERNAL_CATGIF_PATH)/board/users_table.txt"
BR2_ROOTFS_OVERLAY="$(BR2_EXTERNAL_CATGIF_PATH)/board/overlay"
BR2_ROOTFS_POST_BUILD_SCRIPT="board/raspberrypi3-64/post-build.sh"
BR2_ROOTFS_POST_IMAGE_SCRIPT="board/raspberrypi3-64/post-image.sh"
BR2_LINUX_KERNEL=y
BR2_LINUX_KERNEL_CUSTOM_TARBALL=y
BR2_LINUX_KERNEL_CUSTOM_TARBALL_LOCATION="$(call github,raspberrypi,linux,21b410140c47ffab5668399f6f143c7d7b935c8b)/linux-21b410140c47ffab5668399f6f143c7d7b935c8b.tar.gz"
BR2_LINUX_KERNEL_DEFCONFIG="bcm2711"
BR2_LINUX_KERNEL_DTS_SUPPORT=y
BR2_LINUX_KERNEL_INTREE_DTS_NAME="broadcom/bcm2710-rpi-3-b broadcom/bcm2710-rpi-3-b-plus broadcom/bcm2710-rpi-cm3"
BR2_LINUX_KERNEL_NEEDS_HOST_OPENSSL=y
BR2_PACKAGE_BUSYBOX_SHOW_OTHERS=y
BR2_PACKAGE_XZ=y
BR2_PACKAGE_MESA3D=y
BR2_PACKAGE_MESA3D_GALLIUM_DRIVER_VC4=y
BR2_PACKAGE_MESA3D_OPENGL_ES=y
BR2_PACKAGE_SDL3=y
BR2_PACKAGE_SDL3_KMSDRM=y
BR2_PACKAGE_SDL3_OPENGLES=y
BR2_PACKAGE_SDL3_GFX=y
BR2_PACKAGE_RPI_FIRMWARE=y
BR2_PACKAGE_RPI_FIRMWARE_BOOTCODE_BIN=y
BR2_PACKAGE_RPI_FIRMWARE_VARIANT_PI=y
BR2_PACKAGE_RPI_FIRMWARE_CONFIG_FILE="$(BR2_EXTERNAL_CATGIF_PATH)/board/config.txt"
BR2_PACKAGE_DBUS_GLIB=y
BR2_PACKAGE_SG3_UTILS=y
BR2_PACKAGE_USBMOUNT=y
BR2_PACKAGE_LIBATASMART=y
BR2_PACKAGE_LIBBLOCKDEV=y
BR2_PACKAGE_LIBBLOCKDEV_CRYPTO=y
BR2_PACKAGE_LIBBLOCKDEV_FS=y
BR2_PACKAGE_LIBBLOCKDEV_LOOP=y
BR2_PACKAGE_LIBBLOCKDEV_MDRAID=y
BR2_PACKAGE_LIBBLOCKDEV_NVME=y
BR2_PACKAGE_LIBBLOCKDEV_PART=y
BR2_PACKAGE_LIBBLOCKDEV_SWAP=y
BR2_PACKAGE_LIBGUDEV=y
BR2_PACKAGE_DROPBEAR=y
BR2_PACKAGE_NTP=y
BR2_PACKAGE_KMOD_TOOLS=y
BR2_PACKAGE_POLKIT=y
BR2_PACKAGE_NANO=y
BR2_PACKAGE_VIM=y
BR2_TARGET_ROOTFS_EXT2=y
BR2_TARGET_ROOTFS_EXT2_4=y
BR2_TARGET_ROOTFS_EXT2_SIZE="120M"
# BR2_TARGET_ROOTFS_TAR is not set
BR2_PACKAGE_HOST_DOSFSTOOLS=y
BR2_PACKAGE_HOST_GENIMAGE=y
BR2_PACKAGE_HOST_KMOD_XZ=y
BR2_PACKAGE_HOST_MTOOLS=y
BR2_PACKAGE_CAT_GIF=y
```

## buildroot/package/cat-gif/Config.in
```kconfig
config BR2_PACKAGE_CAT_GIF
    bool "cat_gif"
    depends on !BR2_STATIC_LIBS
    depends on BR2_USE_WCHAR
    depends on BR2_TOOLCHAIN_HAS_THREADS
    depends on BR2_INSTALL_LIBSTDCPP
    depends on BR2_PACKAGE_SDL3_KMSDRM
    select BR2_PACKAGE_SDL3_IMAGE
    help
        This app displays gifs (of cats, hopefully) on a
        screen available through some renderer SDL3 may
        use. gifs are sourced from a user-config'd directory

        This app leaves the choice of SDL renderer up to the
        configurer. For a pi3b+, we recommend enabling
        BR2_PACKAGE_MESA3D_GALLIUM_DRIVER_VC4.
        For other platforms: you're on your own getting SDL3 a render to use.
    
comment "cat_gif, b/c of SDL3: needs dynamic libs, threads, cpp17, sdl-kmsdrm and wchar support"
    depends on BR2_STATIC_LIBS || !BR2_TOOLCHAIN_HAS_THREADS || !BR2_USE_WCHAR || !BR2_INSTALL_LIBSTDCPP || !BR2_PACKAGE_SDL3_KMSDRM
```
